## arch/arm/mach-hifone/Kconfig
```kconfig
if ARCH_HIFONE
menu "HIFONE board feature"

config MACH_HIFONE
	bool "Support HiFone platform"
	select CPU_V7
	select ARM_GIC
	select ARM_TIMER_SP804
	select COMMON_CLK
	select PCI_DOMAINS if PCI
	help
	  Include support for the hisilion HIFONE platform.
	  HIFONE support ARM CORTEX-A17 processer,
	  within a Generic Interrupt Controller.
	  Support DDR2 and DDR3.

config DEFAULT_UART_BASE_ADDR
	hex "Default uart controller base address"
	default "0xF8B00000"
	help
	  Default UART controller base address

menuconfig SUPPORT_DSP_RUN_MEM
	bool "Support DSP run memory"
	default y
	help
	  Support DSP run memory

config DSP_RUN_MEM_ADDR
	hex "DSP run memory address"
	depends on SUPPORT_DSP_RUN_MEM
	default "0x2000000"
	help
	  The start address of DSP run memory.

config DSP_RUN_MEM_SIZE
	hex "DSP run memory size"
	depends on SUPPORT_DSP_RUN_MEM
	default "0x800000"
	help
	  The size of DSP run memory.

endmenu
endif
```

## drivers/hisilicon/ir/Kconfig
```kconfig
menu "Hisilicon IR drivers"
config HISI_IR
	tristate "Hisilicon IR remote control"
	select MEDIA_SUPPORT
	select MEDIA_RC_SUPPORT
	select RC_DECODERS
	select RC_DEVICES
	select RC_CORE
	select INPUT
	default n
	---help---
	   Say Y here if you want to use hisilicon remote control.

if HISI_IR
menu "Hisilicon IR key map driver"

config HISI_NEC_SIMPLE_ATTO
	tristate "atto nec simple"
	default m

config HISI_NEC_SIMPLE_HISILICON
	tristate "hisilicon nec simple"
	default m

endmenu #HISI_IR
endif #HISI_IR

endmenu #HISI_IR
```

## drivers/hisilicon/misc/Kconfig
```kconfig
config MTD_BLOCK_ROMBLOCK
	tristate "Readonly(romblock) block device access to MTD devices"
	depends on BLOCK
	select MTD_BLKDEVS
	default y
	help
	  Same as readonly block driver, but this allow you to mount read-only
	  file systems from an MTD device, containing bad blocks.

config PART_CHANGE
	bool "Support change partition by file '/proc/partchange'"
	default y
	select BLK_CMDLINE_PARSER
	select CMDLINE_PARTITION
	---help---
	  Support change partition by file '/proc/partchange'
```

## drivers/hisilicon/soc/hi3798cv200/Kconfig
```kconfig
config CPU_IDLE_HI3798CV2X
        bool "CPU Idle Driver for Hisilicon Hi3798cv2x processors"
        depends on ARCH_HI3798CV2X
        help
          Select this to enable cpuidle on Hi3798cv2x processors.

config POWER_RESET_HI3798CV2X
	bool "hisi hi3798cv2x platform reset driver"
	depends on ARCH_HI3798CV2X
	default y if ARCH_HI3798CV2X
	help
	  This driver supports reset hisi arm platform.
```

## drivers/hisilicon/tee/tee_hisi/tzdriver/Kconfig
```kconfig
config SECURE_EXTENSION
        bool "security extension support"
        default n
        help
          Include Security Extension.

config  TZDRIVER
    tristate "Secure Execution Communicator driver"
    default n
    depends on SECURE_EXTENSION
    help
      Provides a communication interface between userspace and
      TrustZone Operating Environment.

config TEELOG
       tristate "Secure Execution TEE Log"
       default n
       depends on TZDRIVER
       help
       TEEOS log

config TC_DEBUG
	bool "TEEC Kernel API debug"
	default n
	help
	  TEEC Kernel API debug

config TC_VERBOSE
	bool "TEEC Kernel API verbose debug info"
	default n
	depends on TC_DEBUG
	help
	  TEEC Kernel API verbose debug info

config RDR_MEM_ADDR
	hex "RDR Log Memory Start Address"
	default 0x2A800000
	depends on TEELOG
	help
	  RDR Memory Start Address

config RDR_LOG_SIZE
	hex "RDR Log Memory Size"
	default 0x800000
	depends on TEELOG
	help
	  RDR Log Memory Size

config TEE_TUI
       tristate "Trusted user interface driver"
       default n
       depends on TZDRIVER
       help
       Trusted user interface diver
config HISI_SPI_SMC
	bool "hisi spi smc"
	default n
```
